#include <SPI.h>

const int SS_Pin = 10;

byte status_reg = 0;

byte address[3] = {0x00,0x00,0x00};

struct fin { byte lsb,msb; };

static fin data[] = 
{
  {0x00,0x00},{0x77,0x00},{0x88,0x80},{0x88,0x80},{0x88,0x80},{0x80,0x80},{0x80,0x80},{0x00,0x00}, //0-7
  {0x00,0x00},{0x07,0x00},{0x08,0x80},{0x08,0x80},{0x08,0x80},{0x08,0x80},{0x08,0x80},{0xFF,0x00}, //8-15
  {0x00,0x00},{0x00,0x00},{0xFF,0x80},{0x80,0x00},{0x80,0x00},{0x80,0x00},{0x80,0x00},{0x80,0x00}, //16-23
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  {0x00,0x00},{0x00,0x00},{0x00,0x00},{0x00,0x00},{0x00,0x00},{0x00,0x00},{0x00,0x00},{0x00,0x00}, //248-255
};

fin read_back[256] = {};

struct instruction{
  const static byte READ   = B00000011;
  const static byte WRITE  = B00000010;
  const static byte WREN   = B00000110;
  const static byte WRDI   = B00000100;
  const static byte RDSR   = B00000101;
  const static byte WRSR   = B00000001;
  const static byte PE_    = B01000010;
  const static byte SE_    = B11011000;
  const static byte CE_    = B11000111;
  const static byte RDID   = B10101011;
  const static byte DPD    = B10111001;
};
struct instruction instr;

void setup(){
  pinMode (SS_Pin, OUTPUT);
  DDRD = DDRD | B11111100;
  // initialize SPI:
  SPI.begin();
  SPI.setDataMode(SPI_MODE0);
  SPI.setClockDivider(SPI_CLOCK_DIV2);
  SPI.setBitOrder(MSBFIRST);
  
  PORTD = 11110000;
}

void loop(){
  
  //Read Status Register

  PORTD = B11100000;
  SPI.transfer(instr.RDSR);
  status_reg = SPI.transfer(0);
  PORTD = B11110000;
  
  Serial.begin(9600);
  Serial.print("Status REG = ");
  Serial.println(status_reg,BIN);

  Serial.println("Setting WREN");
  Serial.end();
  
  //Enable Write Enable Latch
  
  PORTD = B11100000;
  SPI.transfer(instr.WREN);
  PORTD = B11110000;

  PORTD = B11100000;
  SPI.transfer(instr.RDSR);
  status_reg = SPI.transfer(0);
  PORTD = B11110000;

  Serial.begin(9600);
  Serial.print("Status REG = ");
  Serial.println(status_reg,BIN);

  Serial.println("Beginning WRITE");
  Serial.end();
  
  //Write to EEPROM
  
  PORTD = B11100000;
  SPI.transfer(instr.WRITE);
  SPI.transfer(address[0]);
  SPI.transfer(address[1]);
  SPI.transfer(address[2]);
  
  int i=0;
  
  for(int i=0; i<128; i++){
    SPI.transfer(data[i].lsb);
    SPI.transfer(data[i].msb);
  }
  
  PORTD = B11110000;
  
  address[1] = 0x01;
  
  delay(15);
  
  PORTD = B11100000;
  SPI.transfer(instr.WREN);
  PORTD = B11110000;
  
  PORTD = B11100000;
  SPI.transfer(instr.WRITE);
  SPI.transfer(address[0]);
  SPI.transfer(address[1]);
  SPI.transfer(address[2]);
  
  for(int i=128; i<256; i++){
    SPI.transfer(data[i].lsb);
    SPI.transfer(data[i].msb);
  }
  
  PORTD = B11110000;
  
  delay(6);
  
  PORTD = B11100000;
  SPI.transfer(instr.RDSR);
  status_reg = SPI.transfer(0);
  PORTD = B11110000;
  
  Serial.begin(9600);
  Serial.print("Status REG = ");
  Serial.println(status_reg,BIN);

  Serial.println("Beginning READ");
  Serial.end();
  
  //Read from EEPROM
  
  address[1] = 0x00;
  
  PORTD = B11100000;
  SPI.transfer(instr.READ);
  SPI.transfer(address[0]);
  SPI.transfer(address[1]);
  SPI.transfer(address[2]);
  
  for(int i=0; i<256; i++){
    read_back[i].lsb = SPI.transfer(0);
    read_back[i].msb = SPI.transfer(0);
  }
  
  PORTD = B11110000;

  Serial.begin(9600);
  Serial.println("Printing READ result");
  
  for(int i=0; i<256; i++){
    Serial.print("Data[");
    Serial.print(i);
    Serial.print("].lsb = ");
    Serial.println(read_back[i].lsb,HEX);
    Serial.print("Data[");
    Serial.print(i);
    Serial.print("].msb = ");
    Serial.println(read_back[i].msb,HEX);
  }
  Serial.end();
  
  //Read status register
  
  PORTD = B11100000;
  SPI.transfer(instr.RDSR);
  status_reg = SPI.transfer(0);
  PORTD = B11110000;
  
  Serial.begin(9600);
  Serial.print("Status REG = ");
  Serial.println(status_reg,BIN);
  Serial.end();

  while(1){}
}


